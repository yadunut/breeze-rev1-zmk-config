## config/boards/shields/AfternoonLabsBreezeRev1/Kconfig.defconfig
```kconfig
if SHIELD_BREEZE_REV1_LEFT

config ZMK_KEYBOARD_NAME
	default "Breeze Keyboard"

config ZMK_SPLIT_BLE_ROLE_CENTRAL
	default y

endif

if SHIELD_BREEZE_REV1_LEFT || SHIELD_BREEZE_REV1_RIGHT

config ZMK_SPLIT
	default y
 
endif
```

## config/boards/shields/AfternoonLabsBreezeRev1/Kconfig.shield
```kconfig
# Copyright (c) 2022 The ZMK Contributors
# SPDX-License-Identifier: MIT

config SHIELD_BREEZE_REV1_LEFT
    def_bool $(shields_list_contains,breeze_rev1_left)

config SHIELD_BREEZE_REV1_RIGHT
    def_bool $(shields_list_contains,breeze_rev1_right)
```

## config/boards/shields/BreezeMX/Kconfig.defconfig
```kconfig
if SHIELD_BREEZE_MX_LEFT

config ZMK_KEYBOARD_NAME
	default "MX Breeze"

config ZMK_SPLIT_BLE_ROLE_CENTRAL
	default y

endif

if SHIELD_BREEZE_MX_LEFT || SHIELD_BREEZE_MX_RIGHT

config ZMK_SPLIT
	default y
 
endif
```

## config/boards/shields/BreezeMX/Kconfig.shield
```kconfig
# Copyright (c) 2022 The ZMK Contributors
# SPDX-License-Identifier: MIT

config SHIELD_BREEZE_MX_LEFT
    def_bool $(shields_list_contains,breeze_mx_left)

config SHIELD_BREEZE_MX_RIGHT
    def_bool $(shields_list_contains,breeze_mx_right)
```
